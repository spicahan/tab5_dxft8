## rf_board_mock/main/Kconfig.projbuild
```kconfig
menu "Tab5 DXFT8 mock configuration"

    config DXFT8_MOCK_I2C_SDA_GPIO
        int "YD-ESP32-23 SDA GPIO"
        range 0 48
        default 8
        help
            GPIO connected to the Tab5 I2C SDA signal.

    config DXFT8_MOCK_I2C_SCL_GPIO
        int "YD-ESP32-23 SCL GPIO"
        range 0 48
        default 9
        help
            GPIO connected to the Tab5 I2C SCL signal.

    config DXFT8_MOCK_SI5351_ADDRESS
        hex "Emulated Si5351 7-bit address"
        range 0x08 0x77
        default 0x60
        help
            Unshifted seven-bit I2C address. The normal Si5351 address is
            0x60; do not enter the on-wire value 0xC0.

    config DXFT8_MOCK_SI5351_REFERENCE_HZ
        int "Emulated Si5351 reference frequency (Hz)"
        range 10000000 40000000
        default 26000000
        help
            Nominal reference frequency used when decoding and validating the
            programmed PLL and clock outputs. Barb's RF-board v1.3 schematic
            AC-couples a 26 MHz active oscillator into XA and leaves XB open.

    choice DXFT8_MOCK_SI5351_REFERENCE_MODE
        prompt "Expected Si5351 register 183 reference mode"
        default DXFT8_MOCK_SI5351_EXTERNAL_REFERENCE
        help
            Select the reference wiring that the host is expected to program.
            The mock checks register 183 when an output is enabled. The RF-board
            v1.3 default is an active external reference on XA, which uses the
            zero-capacitance code plus the required reserved-bit pattern.

        config DXFT8_MOCK_SI5351_EXTERNAL_REFERENCE
            bool "Active external reference on XA (0x12)"

        config DXFT8_MOCK_SI5351_CRYSTAL_6PF
            bool "Passive crystal, 6 pF load (0x52)"

        config DXFT8_MOCK_SI5351_CRYSTAL_8PF
            bool "Passive crystal, 8 pF load (0x92)"

        config DXFT8_MOCK_SI5351_CRYSTAL_10PF
            bool "Passive crystal, 10 pF load (0xD2)"
    endchoice

    config DXFT8_MOCK_I2C_INTERNAL_PULLUPS
        bool "Enable ESP32-S3 weak internal I2C pull-ups"
        default n
        help
            Leave this disabled when using Tab5, which provides pull-ups.
            It can be enabled for a short-wire bench test whose master has
            no pull-ups, but proper external pull-ups are preferred.

    config DXFT8_MOCK_LOG_TRANSACTIONS
        bool "Log Si5351 register transactions"
        default y
        help
            Log received writes and single-byte read responses over UART0.

    menu "PCM1808 I2S emulator"

        config DXFT8_MOCK_I2S_MCLK_GPIO
            int "MCLK monitor GPIO"
            range 0 48
            default 4
            help
                Connect to Tab5 MCLK. The ESP32-S3 pulse counter measures this
                signal independently; the I2S slave itself does not use MCLK.

        config DXFT8_MOCK_I2S_BCLK_GPIO
            int "I2S BCLK input GPIO"
            range 0 48
            default 5

        config DXFT8_MOCK_I2S_LRCK_GPIO
            int "I2S LRCK/WS input GPIO"
            range 0 48
            default 6

        config DXFT8_MOCK_I2S_DOUT_GPIO
            int "I2S DOUT GPIO"
            range 0 48
            default 7

        config DXFT8_MOCK_I2S_SAMPLE_RATE_HZ
            int "Expected I2S sample rate (Hz)"
            range 8000 96000
            default 48000
            help
                The production PCM1808 interface uses 48 kHz. The mock is an
                I2S slave, so BCLK and LRCK are supplied by the Tab5.

        config DXFT8_MOCK_MONITOR_MCLK
            bool "Measure the Tab5 MCLK with the pulse counter"
            default y

        config DXFT8_MOCK_MCLK_TOLERANCE_PERCENT
            int "MCLK measurement tolerance (percent)"
            depends on DXFT8_MOCK_MONITOR_MCLK
            range 1 20
            default 5
            help
                Accounts for the short software-timed measurement gate. This
                checks gross clock errors; it is not a crystal-accuracy test.

    endmenu

endmenu
```

## tab5/main/Kconfig.projbuild
```kconfig
menu "TAB5 DXFT8 bring-up"

config DXFT8_TAB5_I2C_SDA_GPIO
    int "Port A SDA GPIO"
    range 0 63
    default 53

config DXFT8_TAB5_I2C_SCL_GPIO
    int "Port A SCL GPIO"
    range 0 63
    default 54

config DXFT8_TAB5_I2C_FREQUENCY_HZ
    int "I2C clock frequency (Hz)"
    range 10000 400000
    default 100000

config DXFT8_TAB5_I2C_INTERNAL_PULLUPS
    bool "Enable ESP32-P4 internal I2C pull-ups"
    default y
    help
        Suitable for the short Port A jumper used during bring-up.  The RF
        daughter board should provide external pull-ups for production use.

config DXFT8_SI5351_ADDRESS
    hex "Si5351 7-bit I2C address"
    range 0x08 0x77
    default 0x60

config DXFT8_SI5351_REFERENCE_HZ
    int "Si5351 reference frequency (Hz)"
    range 10000000 40000000
    default 26000000
    help
        Barb's RF-board v1.3 uses a 26 MHz active oscillator coupled into XA.
        This remains configurable for development modules with another
        reference frequency.

choice DXFT8_SI5351_REFERENCE_MODE
    prompt "Si5351 XA reference mode"
    default DXFT8_SI5351_EXTERNAL_REFERENCE
    help
        Select the input type and internal load capacitance for register 183.
        The RF-board schematic uses an AC-coupled external oscillator, which
        requires the 0 pF setting. Passive-crystal modules must match their
        crystal's specified load capacitance.

config DXFT8_SI5351_EXTERNAL_REFERENCE
    bool "External clock on XA (0 pF; RF-board v1.3)"

config DXFT8_SI5351_CRYSTAL_6PF
    bool "Passive crystal, 6 pF"

config DXFT8_SI5351_CRYSTAL_8PF
    bool "Passive crystal, 8 pF"

config DXFT8_SI5351_CRYSTAL_10PF
    bool "Passive crystal, 10 pF"

endchoice

config DXFT8_RUN_TX_PATH_SELF_TEST
    bool "Briefly exercise the TX clock-enable mask"
    default n
    help
        Enables CLK0 briefly while keeping CLK1/QSD running, matching the
        RF-board's normal transmit clock state. This does not operate the
        separate G47/G48 T/R controls.
        Enable this only for the RF-board mock acceptance test.  It must stay
        disabled when a powered PA or antenna is connected.

menu "PCM1808 I2S validation"

config DXFT8_RUN_I2S_SELF_TEST
    bool "Run the I2S validation after the Si5351 test"
    default y
    help
        Starts the ESP32-P4 as I2S master RX on the RF-card M5-Bus pins.
        Disable this to retain an I2C-only test when the I2S wires are absent.

config DXFT8_TAB5_I2S_MCLK_GPIO
    int "MCLK/SCKI output GPIO"
    depends on DXFT8_RUN_I2S_SELF_TEST
    range 0 63
    default 16

config DXFT8_TAB5_I2S_BCLK_GPIO
    int "BCLK output GPIO"
    depends on DXFT8_RUN_I2S_SELF_TEST
    range 0 63
    default 45

config DXFT8_TAB5_I2S_LRCK_GPIO
    int "LRCK/WS output GPIO"
    depends on DXFT8_RUN_I2S_SELF_TEST
    range 0 63
    default 3

config DXFT8_TAB5_I2S_DIN_GPIO
    int "ADC DOUT / Tab5 DIN GPIO"
    depends on DXFT8_RUN_I2S_SELF_TEST
    range 0 63
    default 4

config DXFT8_TAB5_I2S_SAMPLE_RATE_HZ
    int "I2S sample rate (Hz)"
    depends on DXFT8_RUN_I2S_SELF_TEST
    range 8000 96000
    default 48000
    help
        Production default: Fs=48 kHz, MCLK=256fs (12.288 MHz), stereo
        32-bit slots and 64 BCLK per frame (3.072 MHz BCLK).

choice DXFT8_I2S_TEST_MODE
    prompt "I2S validation mode"
    depends on DXFT8_RUN_I2S_SELF_TEST
    default DXFT8_I2S_MOCK_PATTERN_TEST
    help
        Select the deterministic YD-board test for bench wiring, or ordinary
        sample statistics for the eventual real PCM1808. The mock-pattern
        test is expected to fail when connected to real audio.

config DXFT8_I2S_MOCK_PATTERN_TEST
    bool "Validate the YD-board mock pattern"

config DXFT8_I2S_CAPTURE_STATS
    bool "Capture and summarize real PCM1808 samples"

endchoice

config DXFT8_I2S_TEST_FRAMES
    int "Frames to validate/capture"
    depends on DXFT8_RUN_I2S_SELF_TEST
    range 480 480000
    default 4800
    help
        At 48 kHz, 4800 frames represents 100 ms. The deterministic pattern
        test checks every frame for channel order, alignment and continuity.

endmenu

endmenu
```
